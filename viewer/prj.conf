## CMakeLists.txt
```
cmake_minimum_required(VERSION 3.20.0)
find_package(Zephyr REQUIRED HINTS $ENV{ZEPHYR_BASE})
project(csse4011Project)

# App source (main.c in viewer/src)
target_sources(app PRIVATE
        src/main.c
        ../lib/viewer.c
)

# Include headers if any
target_include_directories(app PRIVATE ../include)
```

## prj.conf
```kconfig
# Core system
CONFIG_MAIN_THREAD_PRIORITY=0
CONFIG_MAIN_STACK_SIZE=4096

# Console & logging
CONFIG_PRINTK=y
CONFIG_LOG=y
CONFIG_LOG_MODE_DEFERRED=y
CONFIG_LOG_DEFAULT_LEVEL=3
CONFIG_CONSOLE=y
CONFIG_UART_CONSOLE=y

# Serial & shell
CONFIG_SERIAL=y
CONFIG_SHELL=y
CONFIG_SHELL_BACKEND_SERIAL=y

# Display & LVGL
CONFIG_DISPLAY=y
CONFIG_LVGL=y
CONFIG_LV_Z_MEM_POOL_SIZE=16384
CONFIG_LV_DRAW_SW_COMPLEX=y
CONFIG_LV_FONT_MONTSERRAT_20=y
CONFIG_LV_FONT_MONTSERRAT_28=y   # ← enable 28 pt

CONFIG_LV_USE_SVG=y

# JSON (if your UI uses it)
CONFIG_JSON_LIBRARY=y

# Bluetooth
CONFIG_BT=y
CONFIG_BT_CENTRAL=y
CONFIG_BT_OBSERVER=y
CONFIG_BT_HCI=y

CONFIG_BT_PERIPHERAL=y
CONFIG_BT_DEVICE_NAME="M5Core2"

# Build output
CONFIG_BUILD_OUTPUT_HEX=y
```

## src/main.c
```c
#include <zephyr/kernel.h>
#include <zephyr/logging/log.h>
#include "viewer.h"

LOG_MODULE_REGISTER(main, LOG_LEVEL_INF);

int main(void)
{
    LOG_INF("Starting viewer application...");

    start_ui_thread();

    while (1) {
        k_sleep(K_SECONDS(1));
    }

    return 0;
}
```
