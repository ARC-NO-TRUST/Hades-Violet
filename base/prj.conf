## CMakeLists.txt
```
cmake_minimum_required(VERSION 3.20.0)
find_package(Zephyr REQUIRED HINTS $ENV{ZEPHYR_BASE})
project(csse4011Project)

# Collect all the source files in app/prac3/src
FILE(GLOB app_sources src/*.c)

# Collect all the source files in lib. Note that
# the path given needs to be relative to the
# CMakeLists root, which is app/prac3 here,
# hence the ../../lib.c.
FILE(GLOB lib_sources ../lib/bt_base.c)

# Tell CMake to build with the app and lib sources
target_sources(app PRIVATE ${app_sources} ${lib_sources})

# Tell CMake where our header files are
target_include_directories(app PRIVATE ../include)
```

## prj.conf
```kconfig
# Logging & shell
CONFIG_PRINTK=y
CONFIG_SHELL=y
CONFIG_SHELL_BACKEND_SERIAL=y
CONFIG_SERIAL=y
CONFIG_UART_CONSOLE=y
CONFIG_CONSOLE=y

# Stack
CONFIG_MAIN_STACK_SIZE=2048
CONFIG_BT=y
CONFIG_BT_OBSERVER=y
CONFIG_BT_HCI=y
CONFIG_BT_DEVICE_NAME="ARC_NO_BASE"
CONFIG_BT_DEVICE_APPEARANCE=0
CONFIG_BT_PRIVACY=n
CONFIG_BT_MAX_PAIRED=0
CONFIG_BT_GATT_CACHING=n
CONFIG_BT_GATT_DYNAMIC_DB=n
CONFIG_BT_SETTINGS=n
CONFIG_BT_ATT_PREPARE_COUNT=0
```

## src/main.c
```c
#include "bt_base.h"
#include <zephyr/types.h>
#include <stddef.h>
#include <zephyr/sys/printk.h>
#include <zephyr/sys/util.h>
#include <zephyr/bluetooth/bluetooth.h>
#include <zephyr/bluetooth/hci.h>
#include <zephyr/bluetooth/uuid.h>
#include <zephyr/shell/shell.h>


void bt_ready(int err)
{
	if (err) {
		printk("[MAIN] Bluetooth init failed (err %d)\n", err);
		return;
	}
	printk("[MAIN] Bluetooth init success\n");
}


int main(void)
{
	int err;

	/* Initialize the Bluetooth Subsystem */
	err = bt_enable(bt_ready);
	if (err) {
		printk("[MAIN] Bluetooth init failed (err %d)\n", err);
	} else {
        printk("[MAIN] Bluetooth init success\n");
    }
    (void)start_mobile_scan_thread();
 
	return 0;
}
```
