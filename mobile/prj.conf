## CMakeLists.txt
```
cmake_minimum_required(VERSION 3.20.0)
find_package(Zephyr REQUIRED HINTS $ENV{ZEPHYR_BASE})
project(csse4011Prac3)

# Collect all the source files in app/prac3/src
FILE(GLOB app_sources src/*.c)

# Collect all the source files in lib. Note that
# the path given needs to be relative to the
# CMakeLists root, which is app/prac3 here,
# hence the ../../lib.c.
FILE(GLOB lib_sources ../lib/accelerometer.c 
                      ../lib/bt_mobile.c)

# Tell CMake to build with the app and lib sources
target_sources(app PRIVATE ${app_sources} ${lib_sources})

# Tell CMake where our header files are
target_include_directories(app PRIVATE ../include)
```

## prj.conf
```kconfig
# Core Bluetooth support
CONFIG_BT=y
CONFIG_BT_DEVICE_NAME="TY-52"
CONFIG_BT_DEVICE_APPEARANCE=0
CONFIG_BT_PRIVACY=n  

# Enable Bluetooth advertising support
CONFIG_BT_OBSERVER=y        # Needed for scan/observer role
CONFIG_BT_BROADCASTER=y     # Needed to advertise (required!)

# Enable Bluetooth stack initialization via bt_enable()
CONFIG_BT_PERIPHERAL=y      # Optional, if you might want to be connectable later

# Shell and logging over RTT
CONFIG_UART_CONSOLE=n
CONFIG_RTT_CONSOLE=y
CONFIG_USE_SEGGER_RTT=y
CONFIG_SHELL=y
CONFIG_SHELL_BACKENDS=y
CONFIG_SHELL_BACKEND_RTT=y
CONFIG_LOG_BACKEND_UART=n

CONFIG_SENSOR=y
CONFIG_LIS2DH=y
CONFIG_I2C=y
CONFIG_GPIO=y
```

## src/main.c
```c
#include <zephyr/types.h>
#include <stddef.h>
#include <zephyr/sys/printk.h>
#include <zephyr/sys/util.h>
#include <zephyr/drivers/gpio.h>
#include <zephyr/bluetooth/bluetooth.h>
#include <zephyr/bluetooth/hci.h>
#include <zephyr/bluetooth/uuid.h>
#include <zephyr/shell/shell.h>
#include "accelerometer.h"
#include "bt_mobile.h"

#define LED0_NODE DT_ALIAS(led0)
static const struct gpio_dt_spec led = GPIO_DT_SPEC_GET(LED0_NODE, gpios);


int main(void) {
    int ret;

	if (!gpio_is_ready_dt(&led)) {
		return -1;
	}
	ret = gpio_pin_configure_dt(&led, GPIO_OUTPUT_ACTIVE);
	if (ret < 0) {
		return -1;
	}

    (void)accelerometer_init();
	(void)mobile_bluetooth_init();
    printk("[MAIN] Accelerometer Started Successfully\n");
    return 0;
}
```
