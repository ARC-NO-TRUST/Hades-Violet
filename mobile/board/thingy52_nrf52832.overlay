/{
		soc {
			radio: radio@40001000 {
				compatible = "nordic,nrf-radio";
				reg = <0x40001000 0x1000>;
				interrupts = <1 NRF_DEFAULT_IRQ_PRIORITY>;
				status = "okay";
				ble-2mbps-supported;
	
				/* Note: In the nRF Connect SDK the SoftDevice Controller
				 * is added and set as the default Bluetooth Controller.
				 */
				bt_hci_controller: bt_hci_controller {
					compatible = "zephyr,bt-hci-ll-sw-split";
					status = "okay";
				};
			};
		};

		
};


